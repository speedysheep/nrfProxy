## testcase.yaml
```yaml
# Build-only Twister scenarios for the six nrfProxy configurations.
# Run from an NCS workspace with this repo as -T / path, e.g.:
#   west twister -T /path/to/nrfProxy -v --integration
# If Twister cannot resolve community boards / sysbuild cleanly, fall back to
# build.ps1 + scripts/check_configs.py (assertions matter more than the harness).

tests:
  app.build.dk:
    sysbuild: true
    build_only: true
    platform_allow:
      - nrf52840dk/nrf52840
    extra_args:
      - SB_CONFIG_PARTITION_MANAGER=n

  app.build.xiao:
    sysbuild: true
    build_only: true
    platform_allow:
      - xiao_ble/nrf52840
    extra_args:
      - SB_CONFIG_PARTITION_MANAGER=n

  app.build.xiao_prod:
    sysbuild: true
    build_only: true
    platform_allow:
      - xiao_ble/nrf52840
    extra_args:
      - SB_CONFIG_PARTITION_MANAGER=n
      - EXTRA_CONF_FILE=prod.conf

  app.build.promicro:
    sysbuild: true
    build_only: true
    platform_allow:
      - promicro_nrf52840/nrf52840/uf2
    extra_args:
      - SB_CONFIG_PARTITION_MANAGER=n

  app.build.promicro_prod:
    sysbuild: true
    build_only: true
    platform_allow:
      - promicro_nrf52840/nrf52840/uf2
    extra_args:
      - SB_CONFIG_PARTITION_MANAGER=n
      - EXTRA_CONF_FILE=prod.conf

  app.build.dongle:
    sysbuild: true
    build_only: true
    platform_allow:
      - nrf52840dongle/nrf52840
    extra_args:
      - SB_CONFIG_PARTITION_MANAGER=n
```

## tests/integration/uart_bridge/testcase.yaml
```yaml
tests:
  uart_bridge.integration:
    platform_allow:
      - native_sim
    tags:
      - uart_bridge
      - integration
```

## tests/unit/hooks/testcase.yaml
```yaml
tests:
  proxy_core.hooks:
    platform_allow:
      - native_sim
    tags:
      - proxy_core
      - unit
```

## tests/unit/identity/testcase.yaml
```yaml
tests:
  proxy_core.identity:
    platform_allow:
      - native_sim
    tags:
      - proxy_core
      - unit
```

## tests/unit/policy/testcase.yaml
```yaml
tests:
  proxy_core.policy:
    platform_allow:
      - native_sim
    tags:
      - proxy_core
      - unit
```
